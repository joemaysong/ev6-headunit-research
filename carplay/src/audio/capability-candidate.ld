original_playback_close_continue = 0x5aa2; original_input_continue = 0x3ab0; original_output_continue = 0x3b78; original_formats_continue = 0x3e20; original_create_formats = 0x3cd0; original_latencies_continue = 0x30d8; original_default_latency = 0x4a2c; original_create_latency = 0x2f48; original_array_append = 0x26d4; original_cf_release = 0x26e0; original_cf_equal = 0x26ec; SECTIONS { . = 0x89e0; .text : { *(.text*) } /DISCARD/ : { *(.ARM.exidx*) *(.ARM.extab*) *(.comment*) *(.note*) } }